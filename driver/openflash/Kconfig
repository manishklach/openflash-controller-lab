## driver/openflash/Kconfig
```kconfig
config OPENFLASH
	tristate "OpenFlash experimental NAND controller"
	depends on PCI && BLOCK
	help
	  Experimental driver for the OpenFlash managed NAND controller. It exposes
	  a 4 KiB-blocked disk through one MSI-X backed blk-mq hardware queue.
```
